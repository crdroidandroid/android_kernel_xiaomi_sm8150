## drivers/input/touchscreen/xiaomi/Kconfig
```kconfig
source "drivers/input/touchscreen/xiaomi/fts_521/Kconfig"
source "drivers/input/touchscreen/xiaomi/goodix_driver_gt9886/Kconfig"
source "drivers/input/touchscreen/xiaomi/nt36523/Kconfig"
source "drivers/input/touchscreen/xiaomi/nt36672c/Kconfig"

config I2C_BY_DMA
	bool "I2C BY DMA"

config SECURE_TOUCH
	bool "Secure Touch"

config INPUT_PRESS_NDT
	bool "ndt"
	depends on I2C
	help
	  Say Y here if you have a press ic ndt.

config SPI_XIAOMI_TP
	bool
	depends on SPI
	default y if TOUCHSCREEN_NT36xxx_HOSTDL_SPI
	help
		Say Y if want use xiaomi touch panel.
```

## drivers/platform/xiaomi/Kconfig
```kconfig
# Xiaomi configuration options

config MACH_XIAOMI
	bool "Xiaomi device"
	depends on ARCH_QCOM
	help
	  Support for Xiaomi products

config MACH_XIAOMI_SM8150
	bool "Xiaomi SM8150"
	depends on ARCH_QCOM
	select MACH_XIAOMI
	help
	  Support for Xiaomi SM8150 devices

menu "Xiaomi board selection"

config MACH_XIAOMI_ANDROMEDA
	bool "Xiaomi andromeda board"
	select MACH_XIAOMI_SM8150
	help
	  Support for Mi MIX 3 5G

config MACH_XIAOMI_CEPHEUS
	bool "Xiaomi cepheus board"
	select MACH_XIAOMI_SM8150
	help
	  Support for Mi 9

config MACH_XIAOMI_CRUX
	bool "Xiaomi crux board"
	select MACH_XIAOMI_SM8150
	help
	  Support for Mi 9 Pro 5G

config MACH_XIAOMI_NABU
	bool "Xiaomi nabu board"
	select MACH_XIAOMI_SM8150
	help
	  Support for Xiaomi Pad 5

config MACH_XIAOMI_RAPHAEL
	bool "Xiaomi raphael board"
	select MACH_XIAOMI_SM8150
	help
	  Support for Redmi K20 Pro/Mi 9T Pro

config MACH_XIAOMI_VAYU
	bool "Xiaomi vayu board"
	select MACH_XIAOMI_SM8150
	help
	  Support for POCO X3 Pro

endmenu
```

## drivers/power/supply/halo/Kconfig
```kconfig
menu "HALO Electronics, Inc. Charger support"

config HALO_7221
	tristate "HALO7221 Charge Pump"
	depends on I2C
	help
	  Say Y to include support for HALO 7221 charger pump.
	  HALO 7221 is a charger pump chip.
	  The driver supports charger enable/disable.
	  The driver reports the charger status via the power supply framework.
	  The driver controls 7221 via I2C and
	  supports device-tree interface.

endmenu
```

## drivers/power/supply/lionsemi/Kconfig
```kconfig
menu "Lion Semiconductor Inc. Charger Support"

config LN8282
	tristate "LN8282 Charge Pump"
	depends on I2C
	help
	  Say Y to include support for LN8282 charger pump.
	  LN8282 is a charger pump chip.
	  The driver supports charger enable/disable.
	  The driver reports the charger status via the power supply framework.
	  The driver controls 8282 via I2C and
	  supports device-tree interface.

endmenu
```

## drivers/power/supply/maxim/Kconfig
```kconfig
menu "Maxim Integrated Products, Inc. Charger support"

config BATT_VERIFY_BY_DS28E16
	tristate
	prompt "Support ds28e16 as encryption IC."
	help
	  It needs a onewire physical controller to work.

config ONEWIRE_GPIO
	tristate
	prompt "Support Onewire Driver."
	help
	  It's an onewire driver.

config BATT_VERIFY_BY_DS28E16_NABU
	tristate
	prompt "Support ds28e16 as encryption IC."
	help
	  It needs a onewire physical controller to work.

config ONEWIRE_GPIO_NABU
	tristate
	prompt "Support Onewire Driver."
	help
	  It's an onewire driver.

endmenu
```

## drivers/power/supply/nuvolta/Kconfig
```kconfig
menu "NuVolta Technologies Inc. Charger support"

config CHARGER_NU1618
	tristate "nuvolta nu1618 wireless charger driver"
	help
	  say y here to enable support for nu1618 charger driver.

config RX1619_TRIM
	tristate "RX1619 TRIM"
	depends on I2C
	help
	  Say Y to include support for rx1619 wireless Charger.
	  RX1619 is a wireless battery charger chip.
	  The driver supports charger enable/disable.
	  The driver reports the charger status via the power supply framework.
	  The driver controls rx1619 via I2C and
	  supports device-tree interface.

config RX1619
	tristate "RX1619 wireless Charger"
	depends on I2C
	help
	  Say Y to include support for rx1619 wireless Charger.
	  RX1619 is a wireless battery charger chip.
	  The driver supports charger enable/disable.
	  The driver reports the charger status via the power supply framework.
	  The driver controls rx1619 via I2C and
	  supports device-tree interface.

endmenu
```

## drivers/power/supply/renesas/Kconfig
```kconfig
menu "Renesas Electronics Corporation Charger support"

config IDT_P9220
	tristate "idtp9220 wireless Charger"
	depends on I2C
	help
	  Say Y to include support for idtp9220 wireless Charger.
	  idtp9220 is a wireless battery charger.
	  The driver supports charger enable/disable.
	  The driver reports the charger status via the power supply framework.
	  The driver controls idtp9220 via I2C and
	  supports device-tree interface.

config IDT_P9418
	tristate "idtp9418 wireless Charger"
	depends on I2C
	help
	  Say Y to include support for idtp9418 wireless Charger.
	  idtp9418 is a wireless battery charger.
	  The driver supports charger enable/disable.
	  The driver reports the charger status via the power supply framework.
	  The driver controls idtp9418 via I2C and
	  supports device-tree interface.

endmenu
```

## techpack/Kconfig
```kconfig
menu "Tech packages"

source "techpack/audio/Kconfig"

source "techpack/data/Kconfig"

endmenu
```

## techpack/audio/asoc/codecs/Kconfig
```kconfig
menu "Qualcomm ASoC additional codecs"

source "techpack/audio/asoc/codecs/cs35l41/Kconfig"
source "techpack/audio/asoc/codecs/cs35l41_v2/Kconfig"
source "techpack/audio/asoc/codecs/tas2557/Kconfig"
source "techpack/audio/asoc/codecs/tas256x/Kconfig"
source "techpack/audio/asoc/codecs/tfa98xx/Kconfig"

endmenu
```

## techpack/audio/asoc/codecs/cs35l41/Kconfig
```kconfig
config SND_SOC_CS35L41
	tristate "Cirrus Logic CS35L41 codec"
	help
	  Say Y or M here if you want to add support for the Cirrus Logic
	  CS35L41 codec.
```

## techpack/audio/asoc/codecs/tas2557/Kconfig
```kconfig
config SND_SOC_TAS2557
	tristate "Texas Instruments TAS2557 Smart Amplifier"
	help
	  Say Y here if you want to add support for the TAS2557 Smart Amplifier.

if SND_SOC_TAS2557

config TAS2557_REGMAP
	bool "Texas Instruments TAS2557 Regmap"
	help
	  Say Y here if you want to add support for the TAS2557 Regmap.

config TAS2557_CODEC
	bool "Texas Instruments TAS2557 Codec"
	help
	  Say Y here if you want to add support for the TAS2557 Codec.

config TAS2557_MISC
	bool "Texas Instruments TAS2557 Misc"
	help
	  Say Y here if you want to add support for the TAS2557 Misc.

endif
```

## techpack/audio/asoc/codecs/tas256x/Kconfig
```kconfig
#
# TAS256X codec
#

menuconfig SND_SOC_TAS256X
    tristate "SND_SOC_TAS256X"
    default n

if SND_SOC_TAS256X

config TAS256X_CODEC
    tristate "TAS256X_CODEC"
    default n

config TAS256X_REGMAP
    tristate "TAS256X_REGMAP"
    default n

config TAS25XX_ALGO
    tristate "TAS25XX_ALGO"
    default n

endif
```

## techpack/audio/asoc/codecs/tfa98xx/Kconfig
```kconfig
config SND_SOC_TFA9874
	tristate "NXP TFA9874A audio amplifier"
	help
	  Say Y here if you want to add support for the NXP TFA9874A audio
	  amplifier.
```
